## firmware/main/Kconfig.projbuild
```kconfig
menu "Emmaforo"

    config EMMAFORO_BATTERY_LOG
        bool "Keep a battery log in RAM for test devices"
        default y
        help
            Records a battery sample at a fixed period in a RAM ring buffer that
            survives soft resets (not power loss). A test build of the companion
            app reads it over Bluetooth and exports it as CSV/JSON. Recording
            only happens during the normal loop, so it costs no extra wake-ups.

    config EMMAFORO_BATTERY_LOG_PERIOD_S
        int "Seconds between battery log samples"
        depends on EMMAFORO_BATTERY_LOG
        range 10 3600
        default 120

    config EMMAFORO_BATTERY_LOG_CAPACITY
        int "Battery log samples kept (16 bytes each)"
        depends on EMMAFORO_BATTERY_LOG
        range 256 4096
        default 3072
        help
            3072 samples at 120 s cover a little over four days.

    config EMMAFORO_REMOTE
        bool "Remote control over Wi-Fi (USB, TWT or interval check-in)"
        default n
        help
            Off for now: Wi-Fi is used only to download a firmware the user
            approved in the app. When on, the user can still pair and enable
            remote control from the app; it stays off until they do.

    config EMMAFORO_REMOTE_BROKER
        string "MQTT broker for remote control"
        depends on EMMAFORO_REMOTE
        default "mqtts://emmaforo.michelebigi.it:8883"
        help
            Used only when the user turns remote control on. The app can store
            a different broker and credentials over Bluetooth.

    config EMMAFORO_REMOTE_TWT_INTERVAL_S
        int "TWT wake interval in seconds"
        depends on EMMAFORO_REMOTE
        range 1 60
        default 10
        help
            On battery with a Wi-Fi 6 router, the radio wakes this often to
            receive commands. Longer saves battery, shorter answers sooner.

    config EMMAFORO_HTTP_PORTAL
        bool "Local HTTP page and emmaforo.local (no authentication)"
        default n
        help
            The old setup page on the home network. It has no password, so it
            is off: Bluetooth and the encrypted remote link replace it.

    config EMMAFORO_AUDIO
        bool "Speaker (PAM8302 amplifier, batch3 board)"
        default y
        help
            Tones and voice messages when the lamp changes color. The amplifier
            is off between sounds. On boards without it the pins stay unused.

    config EMMAFORO_AUDIO_SD_GPIO
        int "GPIO that switches the amplifier on (~SD)"
        depends on EMMAFORO_AUDIO
        default 22

    config EMMAFORO_AUDIO_SIGNAL_GPIO
        int "GPIO with the sigma-delta audio signal"
        depends on EMMAFORO_AUDIO
        default 23

endmenu
```

## firmware/sdkconfig.defaults
```kconfig
CONFIG_IDF_TARGET="esp32c6"
CONFIG_ESPTOOLPY_FLASHMODE_QIO=y
CONFIG_ESPTOOLPY_FLASHFREQ_80M=y
CONFIG_ESPTOOLPY_FLASHSIZE_4MB=y
CONFIG_PARTITION_TABLE_CUSTOM=y
CONFIG_PARTITION_TABLE_CUSTOM_FILENAME="partitions.csv"
CONFIG_BOOTLOADER_APP_ROLLBACK_ENABLE=y
CONFIG_MBEDTLS_CERTIFICATE_BUNDLE=y
CONFIG_FREERTOS_HZ=1000
CONFIG_PM_ENABLE=y
CONFIG_FREERTOS_USE_TICKLESS_IDLE=y
CONFIG_BT_LE_SLEEP_ENABLE=y
CONFIG_ESP_PHY_MAC_BB_PD=y
CONFIG_FREERTOS_IDLE_TIME_BEFORE_SLEEP=3
CONFIG_BT_ENABLED=y
CONFIG_BT_NIMBLE_ENABLED=y
```
